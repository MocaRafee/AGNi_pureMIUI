## drivers/input/fingerprint/Kconfig
```kconfig
menu "Fingerprint Drivers"

config FINGERPRINT_FPC1020
	tristate "goodix gf5216 fingerprint drvier support"
	help
	  say y here to enable goodix fingerprint driver support!

source "drivers/input/fingerprint/gf/Kconfig"

source "drivers/input/fingerprint/gf3208/Kconfig"

source "drivers/input/fingerprint/gf3258/Kconfig"

endmenu
```
